## config/west.yml
```yaml
manifest:
  remotes:
    - name: zmkfirmware
      url-base: https://github.com/zmkfirmware
    - name: badjeff
      url-base: https://github.com/badjeff
    - name: pukuhei
      url-base: https://github.com/pukuhei
    - name: prospector
      url-base: https://github.com/t-ogura
  projects:
    - name: zmk
      remote: zmkfirmware
      revision: v0.3
      import: app/west.yml
    - name: zmk-pmw3610-driver
      remote: badjeff
      revision: zmk-0.3
    - name: zmk-tom-oled
      remote: pukuhei
      revision: main
    - name: prospector-zmk-module
      remote: prospector
      revision: v2.2.0
      path: modules/prospector-zmk-module
  self:
    path: config
```
